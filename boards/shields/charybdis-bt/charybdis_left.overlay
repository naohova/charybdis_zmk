#include "charybdis.dtsi"
#include "charybdis_pmw3610.dtsi"

&kscan0 {
	compatible = "zmk,kscan-gpio-matrix";
  diode-direction = "col2row";
	
	col-gpios
        = <&pro_micro 4 (GPIO_ACTIVE_HIGH)> // COL0
        , <&pro_micro 5 (GPIO_ACTIVE_HIGH)> // COL1
        , <&pro_micro 6 (GPIO_ACTIVE_HIGH)> // COL2
        , <&pro_micro 7 (GPIO_ACTIVE_HIGH)> // COL3
	      , <&pro_micro 8 (GPIO_ACTIVE_HIGH)> // COL4
        , <&pro_micro 9 (GPIO_ACTIVE_HIGH)> // COL5
    ;
};

// https://github.com/badjeff/zmk-pmw3610-driver
/ {
  trackball_listener {
    compatible = "zmk,input-listener";
    device = <&trackball>;
  };
};
